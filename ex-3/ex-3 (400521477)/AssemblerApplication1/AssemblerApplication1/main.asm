;
; AssemblerApplication1.asm
;
; Created: 3/11/2024 10:32:27 PM
; Ali Shokoohi
; student ID: 400521477


.include "m32def.inc"
.ORG	0
		RJMP	BEGIN
.ORG	OC1Aaddr
		RJMP	ROUTINE1
.ORG	OC0addr
		RJMP	ROUTINE2

BEGIN:	LDI		R16,HIGH(RAMEND)
		OUT		SPH,R16
		LDI		R16,LOW(RAMEND)
		OUT		SPL,R16


		LDI		R16,0xFF
		OUT		DDRB,R16		
		OUT		DDRC,R16		
		OUT		DDRD,R16		
		OUT		PORTA,R16		
		LDI		R16,0x00
		OUT		DDRA,R16		


		LDI		R16,0x0C 
		OUT		TCCR0,R16	
		LDI		R16,0x00 
		OUT		TCNT0,R16			
		LDI		R16,0x63 
		OUT		OCR0,R16	
		LDI		R16,0x00 
		OUT		TCCR1A,R16
		LDI		R16,0x0C 
		OUT		TCCR1B,R16		
		LDI		R16,0x7A
		OUT		OCR1AH,R16	
		LDI		R16,0x12
		OUT		OCR1AL,R16	
		LDI		R16,0x12
		OUT		TIMSK,R16 
		SEI
		
		LDI		R24,01			
		LDI		R20,0		
		LDI		R21,0		
		LDI		R22,0		
		LDI		R23,0		
		LDI		R30,0		
		RJMP	MAIN

INIT0:	LDI		R20,0
		LDI		R21,0
		LDI		R22,0
		LDI		R23,0
		RJMP	COUNT3

INIT9:	LDI		R20,9
		LDI		R21,9
		LDI		R22,9
		LDI		R23,9
		RJMP	COUNT3

MAIN:
		OUT		PORTB,R24				
		RJMP	DISP

DISP:   CLI

		CPI		R30,1
		BRSH	COUNT4
		LDI		R16,0b11110111	
		OUT		PORTD,R16
		MOV		R16,R20
		CALL	CONVERT
		OUT		PORTC,R16
		RJMP	COUNT7

COUNT4:	CPI		R30,2
		BRSH	COUNT5

		LDI		R16,0b11111011	
		OUT		PORTD,R16
		MOV		R16,R21
		CALL	CONVERT
		OUT		PORTC,R16
		RJMP	COUNT7

COUNT5:	CPI		R30,3
		BRSH	COUNT6

		LDI		R16,0b11111101	
		OUT		PORTD,R16
		MOV		R16,R22
		CALL	CONVERT
		OUT		PORTC,R16
		RJMP	COUNT7

COUNT6:	LDI		R16,0b11111110	
		OUT		PORTD,R16
		MOV		R16,R23
		CALL	CONVERT
		OUT		PORTC,R16

COUNT7:	SEI
		RJMP	MAIN

CONVERT:				
		CPI		R16,0
		BRNE	C1
		LDI		R16,0x3F
		RET
C1:		CPI		R16,1
		BRNE	C2
		LDI		R16,0x06
		RET
C2:		CPI		R16,2
		BRNE	C3
		LDI		R16,0x5B
		RET
C3:		CPI		R16,3
		BRNE	C4
		LDI		R16,0x4F
		RET
C4:		CPI		R16,4
		BRNE	C5
		LDI		R16,0x66
		RET
C5:		CPI		R16,5
		BRNE	C6
		LDI		R16,0x6D
		RET
C6:		CPI		R16,6
		BRNE	C7
		LDI		R16,0x7D
		RET
C7:		CPI		R16,7
		BRNE	C8
		LDI		R16,0x07
		RET
C8:		CPI		R16,8
		BRNE	C9
		LDI		R16,0x7F
		RET
C9:		CPI		R16,9
		BRNE	C10
		LDI		R16,0x6F
C10:	RET

INCREMENT:
		CPI		R20,9
		BRLO	INC1
		CPI		R21,9
		BRLO	INC2
		CPI		R22,9
		BRLO	INC3
		CPI		R23,9
		BRLO	INC4
		RJMP	INIT0

DECREMENT:
		CPI		R20,1
		BRSH	DEC1
		CPI		R21,1
		BRSH	DEC2
		CPI		R22,1
		BRSH	DEC3
		CPI		R23,1
		BRSH	DEC4
		RJMP	INIT9

INC1:
		INC		R20
		RJMP	COUNT3

DEC1:
		DEC		R20
		RJMP	COUNT3

INC2:
		LDI		R20,0
		INC		R21
		RJMP	COUNT3

DEC2:
		LDI		R20,9
		DEC		R21
		RJMP	COUNT3

INC3:
		LDI		R20,0
		LDI		R21,0
		INC		R22
		RJMP	COUNT3

DEC3:
		LDI		R20,9
		LDI		R21,9
		DEC		R22
		RJMP	COUNT3

INC4:
		LDI		R20,0
		LDI		R21,0
		LDI		R22,0
		INC		R23
		RJMP	COUNT3

DEC4:
		LDI		R20,9
		LDI		R21,9
		LDI		R22,9
		DEC		R23
		RJMP	COUNT3

ROUTINE1:
		LSL		R24
		CPI		R24,0
		BRNE	COUNT
		LDI		R24,1
COUNT:	IN		R16,PINA 		
		MOV		R17,R16			
		ANDI	R17,0b00000001	
		CPI		R17,0			
		BRNE	DECREMENT
		RJMP	INCREMENT
COUNT3:	RETI

ROUTINE2:
		INC		R30
		CPI		R30,4
		BRLO	COUNT2
		LDI		R30,0
COUNT2:	RETI
