.include "m32def.inc"
		LDI		R16,HIGH(RAMEND)
		OUT		SPH,R16
		LDI		R16,LOW(RAMEND)
		OUT		SPL,R16

		LDI		R16,0xFF
		OUT		DDRC,R16
		OUT		DDRD,R16

START:	
		;Display the 1st Segment
		LDI		R16,0b11111110
		OUT		PORTD,R16
		LDI		R16,2
		CALL	CONVERT
		OUT		PORTC,R16
		CALL	DELAY

		;Display the 2nd Segment
		LDI		R16,0b11111101
		OUT		PORTD,R16
		LDI		R16,0
		CALL	CONVERT
		OUT		PORTC,R16
		CALL	DELAY

		;Display the 3rd Segment
		LDI		R16,0b11111011
		OUT		PORTD,R16
		LDI		R16,2
		CALL	CONVERT
		OUT		PORTC,R16
		CALL	DELAY

		;Display the 4th Segment
		LDI		R16,0b11110111
		OUT		PORTD,R16
		LDI		R16,4
		CALL	CONVERT		
		OUT		PORTC,R16
		CALL	DELAY

		RJMP	START	

DELAY:	LDI		R17,0x0F
D1:		LDI		R18,0xFF
D2:		DEC		R18
		BRNE	D2
		DEC		R17
		BRNE	D1
		RET

CONVERT:
		CPI		R16,0
		BRNE	C1
		LDI		R16,0x3F
		RET
C1:		CPI		R16,1
		BRNE	C2
		LDI		R16,0x06
		RET	
C2:		CPI		R16,2
		BRNE	C3
		LDI		R16,0x5B
		RET
C3:		CPI		R16,3
		BRNE	C4
		LDI		R16,0x4F
		RET
C4:		CPI		R16,4
		BRNE	C5
		LDI		R16,0x66
		RET
C5:		CPI		R16,5
		BRNE	C6
		LDI		R16,0x6D
		RET
C6:		CPI		R16,6
		BRNE	C7
		LDI		R16,0x7D
		RET
C7:		CPI		R16,7
		BRNE	C8
		LDI		R16,0x07
		RET
C8:		CPI		R16,8
		BRNE	C9
		LDI		R16,0x7F
		RET
C9:		CPI		R16,9
		BRNE	C10
		LDI		R16,0x6F
C10:	RET
